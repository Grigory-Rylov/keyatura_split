#include "keyatura.dtsi"
#include "keyatura_esb_addr.dtsi"

&kscan0 {
    row-gpios
        = <&gpio1 4  (GPIO_ACTIVE_HIGH | GPIO_PULL_DOWN)>
        , <&gpio1 6  (GPIO_ACTIVE_HIGH | GPIO_PULL_DOWN)>
        , <&gpio0 9  (GPIO_ACTIVE_HIGH | GPIO_PULL_DOWN)>
        , <&gpio0 10 (GPIO_ACTIVE_HIGH | GPIO_PULL_DOWN)>
        ;
    
	col-gpios
        = <&gpio1 11 GPIO_ACTIVE_HIGH>
        , <&gpio1 13 GPIO_ACTIVE_HIGH>
        , <&gpio1 15 GPIO_ACTIVE_HIGH>
        , <&gpio0 2  GPIO_ACTIVE_HIGH>
        , <&gpio0 29 GPIO_ACTIVE_HIGH>
        ;
};

&default_transform {
	col-offset = <5>;
};

&mouse_split {
    status = "disabled";
};